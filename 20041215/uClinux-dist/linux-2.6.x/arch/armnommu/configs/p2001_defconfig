## 20041215/uClinux-dist/linux-2.6.x/arch/armnommu/mach-p2001/Kconfig
```kconfig
menu "P2001 Options"
	depends on ARCH_P2001

config SYSCLK
	int 'SysClk'
	default 73728000
	help
	  The default sysclk is 12.288 MHz. For the ethernet unit to
	  work more than 25 MHz are needed. The sysclk is not set by
	  the linux kernel, but instead by etherboot. So this must be
	  the same as what etherboot is set to.
	  The following system clock frequencies are allowed:
	   12288000:  12.288 MHz
	   24576000:  24.576 MHz
	   36864000:  36.864 MHz
	   49152000:  49.152 MHz
	   61440000:  61.440 MHz
	   73728000:  73.728 MHz
	   86016000:  86.016 MHz
	   98304000:  98.304 MHz
	  110592000: 110.592 MHz
	
config SKIP_DUMP_CPU_INFO
	bool
	default y
	help
	ARM9TDMI cores do not support cache size
	recognition instructions which use MMU features.

endmenu
```
